## dts/bindings/zmk,split-peripheral-ouput-relay.yaml
```yaml
# Copyright (c) 2024 The ZMK Contributors
# SPDX-License-Identifier: MIT

description: |
  Allows defining output relay channels

compatible: "zmk,split-peripheral-output-relay"

properties:
  relay-channel:
    type: int
    required: true
  device:
    type: phandle
    required: true
```
